// SPDX-License-Identifier: GPL-2.0-or-later OR MIT

/dts-v1/;

#include "ipq5018-cr880x.dtsi"

/ {
	model = "Redmi AX3000 / Xiaomi CR880X (M81)";
	compatible = "redmi,ax3000", "xiaomi,cr880x-m81", "qcom,ipq5018";
};

&wifi {
	/delete-property/ qcom,ath11k-calibration-variant;
	qcom,board_id = <0x10>;
	qcom,ath11k-fw-memory-mode = <2>;
};

&wifi1 {
	/delete-property/ qcom,ath11k-calibration-variant;
	qcom,board_id = <0x60>;
	qcom,ath11k-fw-memory-mode = <2>;
};
